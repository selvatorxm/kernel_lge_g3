## arch/arm/hotplug/Kconfig
```kconfig
config ASMP
	bool "Multi-core automatic hotplug support"
	depends on SMP
	default y
	help
          AUTOSMP DUDE
	  
config ALUCARD_HOTPLUG
	bool "Enable alucard-hotplug cpu hotplug driver"
	default y
	help
	  Generic Alucard-hotplug cpu hotplug driver for ARM SOCs
	  
config INTELLI_PLUG
	bool "Enable intelli-plug cpu hotplug driver"
	default y
	help
	  Generic Intelli-plug cpu hotplug driver for ARM SOCs
	  
config BRICKED_HOTPLUG
	bool "Enable kernel based mpdecision"
	depends on MSM_RUN_QUEUE_STATS
	default y
	help
	  This enables kernel based multi core control. 
	  
config MSM_HOTPLUG
	bool "MSM hotplug driver"
	depends on HOTPLUG_CPU
	default y
	help
	  The MSM hotplug driver controls on-/offlining of additional cores based
	  on current cpu load.
	  
config INTELLI_HOTPLUG
	bool "Hotplug for Razor Reborn"
	depends on MSM_RUN_QUEUE_STATS
	default y
	help
	  This enables kernel based multi core control.
```
